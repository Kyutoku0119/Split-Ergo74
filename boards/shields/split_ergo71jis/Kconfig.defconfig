## boards/shields/split_ergo71jis/Kconfig.defconfig
```kconfig
if SHIELD_SPLIT_ERGO71JIS_LEFT

config ZMK_KEYBOARD_NAME
    default "split_ergo71jis"

endif

if SHIELD_SPLIT_ERGO71JIS_LEFT || SHIELD_SPLIT_ERGO71JIS_RIGHT

config ZMK_SPLIT
    default y

endif
```

## boards/shields/split_ergo71jis/Kconfig.shield
```kconfig
config SHIELD_SPLIT_ERGO71JIS_LEFT
    def_bool $(shields_list_contains,split_ergo71jis_left)
config SHIELD_SPLIT_ERGO71JIS_RIGHT
    def_bool $(shields_list_contains,split_ergo71jis_right)
```
